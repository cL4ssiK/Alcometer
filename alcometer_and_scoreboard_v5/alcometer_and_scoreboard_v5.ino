#include <Arduino.h>
#include <U8g2lib.h>
#include <Wire.h>
#include <EEPROM.h>
#include <PushButton.h> // My own class.

#define sensorAnalogA1 A1 // mq3 sensor inpurt to analog pin 1.
#define buttonDigitalD2 2 // Button to digitalpin 2 with pulldown resistor.
// Display sda to analog 4 and scl to analog 5.

#define NAME_LENGTH 7

U8G2_SSD1306_128X64_NONAME_F_HW_I2C u8g2(U8G2_R0, U8X8_PIN_NONE); // Object representing the display.
PushButton pb(buttonDigitalD2);                                   // Object representing the push button. 

// Bitmaps for animation. Generated with lopaka.app
// Stored in flash memory to save RAM.
const unsigned char image_AlgoTextFixed_bits[] U8X8_PROGMEM = {0x00,0x10,0x00,0x00,0x00,0x18,0x00,0x00,0x00,0x18,0x00,0x00,0x00,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0xc3,0x01};
const unsigned char image_Comp_2_00000_bits[] U8X8_PROGMEM = {0x00,0x00,0xe0,0x01,0x00,0x00,0x00,0x00,0xe0,0x01,0x02,0x00,0x00,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0x00,0x00};
const unsigned char image_Comp_2_00001_bits[] U8X8_PROGMEM = {0x00,0x00,0x7c,0xe0,0x00,0x00,0x00,0x00,0xfc,0xe0,0x03,0x00,0x00,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0x00,0x00};
const unsigned char image_Comp_2_00002_bits[] U8X8_PROGMEM = {0x00,0x00,0x0f,0x7c,0x00,0x00,0x00,0x80,0x1f,0xfe,0x00,0x00,0x00,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0x00,0x00};
const unsigned char image_Comp_2_00003_bits[] U8X8_PROGMEM = {0x00,0x00,0x80,0x1f,0x00,0x00,0x00,0xc0,0xc1,0x3f,0x00,0x00,0x00,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0x00,0x00};
const unsigned char image_Comp_2_00004_bits[] U8X8_PROGMEM = {0x00,0x00,0xf0,0x07,0x00,0x00,0x00,0x00,0xf8,0x87,0x03,0x00,0x00,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0x00,0x00};
const unsigned char image_Comp_2_00005_bits[] U8X8_PROGMEM = {0x00,0x00,0xfe,0xe0,0x00,0x00,0x00,0x00,0xfe,0xf8,0x03,0x00,0x00,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0x00,0x00};
const unsigned char image_Comp_2_00006_bits[] U8X8_PROGMEM = {0x00,0x80,0x1f,0x7e,0x00,0x00,0x00,0xc0,0x1f,0xfe,0x00,0x00,0x00,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0x00,0x00};
const unsigned char image_Comp_2_00007_bits[] U8X8_PROGMEM = {0x00,0xc0,0xc1,0x1f,0x00,0x00,0x00,0xf0,0xc7,0x1f,0x00,0x00,0x00,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0x00,0x00};
const unsigned char image_Comp_2_00008_bits[] U8X8_PROGMEM = {0x00,0x00,0xf8,0x03,0x00,0x00,0x00,0x70,0xf8,0x07,0x00,0x00,0x00,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0x00,0x00};
const unsigned char image_Comp_2_00009_bits[] U8X8_PROGMEM = {0x00,0x00,0x7e,0x00,0x00,0x00,0x00,0x00,0xff,0xe0,0x00,0x00,0x00,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0x00,0x00};
const unsigned char image_Comp_2_00010_bits[] U8X8_PROGMEM = {0x00,0x80,0x0f,0x3c,0x00,0x00,0x00,0xc0,0x1f,0x7e,0x00,0x00,0x00,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0x00,0x00};
const unsigned char image_Comp_2_00011_bits[] U8X8_PROGMEM = {0x00,0xc0,0x81,0x0f,0x00,0x00,0x00,0xf0,0xc1,0x0f,0x00,0x00,0x00,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0x00,0x00};

// Bitmaps for save window arrows.
const unsigned char image_SmallArrowDown_bits[] U8X8_PROGMEM = {0x1f,0x0e,0x04};
const unsigned char image_ButtonRight_bits[] U8X8_PROGMEM = {0x01,0x03,0x07,0x0f,0x07,0x03,0x01};
const unsigned char image_ButtonLeft_bits[] U8X8_PROGMEM = {0x08,0x0c,0x0e,0x0f,0x0e,0x0c,0x08};

// Bitmaps for main window images.
const unsigned char image_choice_bullet_off_bits[] U8X8_PROGMEM = {0xe0,0x03,0x38,0x0e,0x0c,0x18,0x06,0x30,0x02,0x20,0x03,0x60,0x01,0x40,0x01,0x40,0x01,0x40,0x03,0x60,0x02,0x20,0x06,0x30,0x0c,0x18,0x38,0x0e,0xe0,0x03,0x00,0x00};
const unsigned char image_choice_bullet_on_bits[] U8X8_PROGMEM = {0xe0,0x03,0x38,0x0e,0xcc,0x19,0xf6,0x37,0xfa,0x2f,0xfb,0x6f,0xfd,0x5f,0xfd,0x5f,0xfd,0x5f,0xfb,0x6f,0xfa,0x2f,0xf6,0x37,0xcc,0x19,0x38,0x0e,0xe0,0x03,0x00,0x00};
const unsigned char image_file_download_bits[] U8X8_PROGMEM = {0x00,0x00,0x80,0x00,0x80,0x00,0x80,0x00,0x80,0x00,0x80,0x00,0x90,0x04,0xe0,0x03,0xc7,0x71,0x85,0x50,0xfd,0x5f,0x01,0x40,0x01,0x40,0xff,0x7f,0x00,0x00,0x00,0x00};
const unsigned char image_chart_bits[] U8X8_PROGMEM = {0x00,0x00,0x01,0x00,0xc1,0x01,0x41,0x01,0x41,0x01,0x41,0x1d,0x41,0x15,0x41,0x15,0x5d,0x15,0x55,0x15,0x55,0x15,0x55,0x15,0xdd,0x1d,0x01,0x00,0xff,0x3f,0x00,0x00};

const unsigned char* const animations[12] PROGMEM = { // Store pointers in flash memory as well to save RAM.
image_Comp_2_00000_bits,
image_Comp_2_00001_bits,
image_Comp_2_00002_bits,
image_Comp_2_00003_bits,
image_Comp_2_00004_bits,
image_Comp_2_00005_bits,
image_Comp_2_00006_bits,
image_Comp_2_00007_bits,
image_Comp_2_00008_bits,
image_Comp_2_00009_bits,
image_Comp_2_00010_bits,
image_Comp_2_00011_bits,
};

// Global variables ------------------------------------------------------
//------------------- Measuring functionality ----------------------------
unsigned long timeline = 0;
bool buttonPressed = false;
char str[8];//5 numbers, decimal point, sign and escape sign should be more than enough.

int data[30]; // Just use sum  to save space? 
int avgReading = 0;
byte datapos = 0;
byte lkm = 0;
//------------------- Scoreboard system ----------------------------------
int top5[5];
char* top5names[5];

byte characterOnPoint = 65; // whole number between 65 and 90.

unsigned long lastCursorDrawTime_ms = 0;
bool draw = true;
byte cursorPosition = 46; // Position for cursor in the beginning.
//-----------------------------------------------------------------------------------

// Defining these signatures on top because complex signatures causes problems otherwise. -ChatGPT
int retrieveStringArray(int eepromAddress, char* strArray[], int maxArraySize, const int static_size = 0);
int storeStringArray(int eepromAddress, char* strArray[], int arraySize, const int static_size=-1);

/**
 * TODOLIST!!!
 * - Add some functionality that new measuring does not begin immediately after exiting scoreboard.
 * - See if some global variables can be made local.
 * - Prettify code.
 * - Documentation.
 * - Calibrate with commercial one.
 * - Optimize power consumption by slowing clock speed here and there.
 * - Add EEPROM reset button/functionality.
 * - Scoreboard row into object.
 * - Use definitions instead of numeric constants, for example top5name length is needed in multiple place and is constant.
 */
void setup() {
  // put your setup code here, to run once:
  pinMode(buttonDigitalD2, INPUT);
  
  u8g2.begin();
  u8g2.setFontMode(1);
  u8g2.setBitmapMode(1);

  //Serial.begin(9600);

  int addr = retrieveStringArray(0, top5names, 5, NAME_LENGTH);
  EEPROM.get(addr + 1, top5);
  
  // Play loading animation while sensor is heating/for fun. 
  timeline = millis();
  byte frame = 0;
  while(millis()-timeline < 10000){
    loadingScreen(frame);
  }
}


void loop() {
  mainView();
  measuringLoop();
}


/**
 * Capsulates the measuring functionality.
 */
void measuringLoop(void){
  setPci(false);
  showEmpty();
  while(true){
    if(digitalRead(buttonDigitalD2)){//TODO: make reading sensor better, so it wont start immediately after exiting scoreboard.
      if(datapos == 0) showReading(); // Only update the window every 3 seconds.
      readSensor();
      buttonPressed = true;
      delay(100);  
    }
    else if(buttonPressed){
      showSensorReading();
      buttonPressed = false;
      datapos = 0;
      lkm = 0;
      timeline = millis();
      setPci(true);
    
      //listen for long press
      bool breakLoop = false;
      while(true){
        pb.handlePress([&breakLoop]() { breakLoop = true; }, [&breakLoop]() { saving_loop(); breakLoop = true; });
        if (breakLoop) break;
      }
      if (breakLoop) break;
    }
  }
}


/**
 * Responsible of the main view.
 */
void mainView(void){
  setPci(true);
  drawMainView();
  bool breakLoop = false;
  while(true){
    pb.handlePress([&breakLoop]() { breakLoop = true; }, [](){ scoreboardView(); drawMainView(); });
    if (breakLoop) break;
  }
}


/**
 * Draws the elements of the main view.
 */
void drawMainView(void){
  u8g2.clearBuffer();
  u8g2.setFontMode(1);
  u8g2.setBitmapMode(1);
  u8g2.drawXBMP(15, 10, 15, 16, image_choice_bullet_off_bits);
  u8g2.drawXBMP(15, 37, 15, 16, image_choice_bullet_on_bits);
  u8g2.setFont(u8g2_font_6x13_tr);
  u8g2.drawStr(35, 23, "Measuring");
  u8g2.drawStr(35, 50, "Scoreboard");
  u8g2.drawXBMP(98, 10, 15, 16, image_file_download_bits);
  u8g2.drawXBMP(99, 36, 14, 16, image_chart_bits);
  u8g2.sendBuffer();
}


/**
 * Checks if score was high enough for top5 and moves names and scores accordingly.
 * @return Score index in the top5 array. -1 if score did not make to the list.
 */
int8_t score(void){
  if (avgReading <= top5[4]) return -1; // If score wasn't high enough return.
  
  int helper = 0;
  char* mover = nullptr;
  int8_t i = 3;
  
  top5[4] = avgReading;
  free(top5names[4]); // Free the memory allocated for old highscore.
  newString(4, NAME_LENGTH + 1);    // Allocate memory for new string to take its position.
  
  for (; i >= 0; i--){
    if (top5[i+1] > top5[i]) { // Moves name and corresponding score syncronously in their arrays.
      helper = top5[i];
      mover = top5names[i];
      top5[i] = top5[i+1];
      top5names[i] = top5names[i+1];
      top5[i+1] = helper;
      top5names[i+1] = mover;
    }
    else break;
  }
  mover = nullptr;
  return i+1;
}


/**
 * Loop to run the functionality of an saving window and scoreboard.
 */
//TODO: move some of the global variables to be local in this function. All are not needed otside this scope
void saving_loop(void){
  pb.reseted = false; //modifying this makes transfer between save window or scoreboard.
  int8_t scoreIndex = score();
  
  if (scoreIndex >= 0 && scoreIndex < 5) writingView((byte)scoreIndex);
  int addr = storeStringArray(0, top5names, 5, NAME_LENGTH);
  EEPROM.put(addr + 1, top5);
  scoreboardView();
}


/**
 * Function that handles functionality of scoreboard view.
 */
void scoreboardView(void){
  bool breakLoop = false;
  while(true){
    drawScoreboard();
    pb.handlePress([]() {}, [&breakLoop]() { breakLoop = true; });
    if (breakLoop) break;
  }
}


/**
 * Function that handles functionality of name writing view.
 */
void writingView(byte index){
  while(true){
    // Listen for button press.
    pb.handlePress(
     [](){
       characterOnPoint++;
       if (characterOnPoint > 90) characterOnPoint = 65;
       }, 
     writeLetter, 
     top5names[index], 
     NAME_LENGTH
    );

    if (millis()-pb.getTimeAtButtonPress_ms() >= 10000) break;  // If nothing happens for 10s hop out of the loop.
    else drawSaveView(index);
  }
  characterOnPoint = 65; // Reset character wheel and cursor position.
  cursorPosition = 46;
}


/**
 * ISR for detecting button press.
 */
ISR(PCINT2_vect){
  pb.reseted = true;
}


/**
 * Draws scoreboard view.
 */
//TODO: Edit this to look better.
void drawScoreboard(void) {
    u8g2.clearBuffer();
    u8g2.drawFrame(0, 0, 128, 64);
    u8g2.setFont(u8g2_font_6x10_tr);
    u8g2.drawStr(34, 9, "Scoreboard");
    u8g2.drawLine(0, 10, 126, 10);
    u8g2.setFont(u8g2_font_5x7_tr);
    u8g2.drawStr(3, 18, "1.");
    u8g2.drawStr(4, 29, "2.");
    u8g2.drawStr(4, 40, "3.");
    u8g2.drawStr(4, 51, "4.");
    u8g2.drawStr(4, 62, "5.");
    u8g2.drawLine(15, 10, 15, 63);
    u8g2.drawLine(0, 31, 126, 31);
    u8g2.drawLine(0, 20, 126, 20);
    u8g2.drawLine(0, 42, 126, 42);
    u8g2.drawLine(0, 53, 126, 53);
    u8g2.drawLine(51, 10, 51, 63);
    u8g2.setFont(u8g2_font_4x6_tr);
    for (byte i = 0; i < 5; i++){
      u8g2.drawStr(22, 18 + i*11, top5names[i]);
      sprintf(str, "%d", top5[i]);
      u8g2.drawStr(57, 18 + i*11, str);
    }
    u8g2.sendBuffer();
}


/**
 * Handles drawing of the saving view.
 * @param index Index of the name that is being edited.
 */
void drawSaveView(byte index) {
    u8g2.clearBuffer();
    u8g2.setFont(u8g2_font_5x7_tr);
    u8g2.drawStr(25, 60, "Wait 10s to save");
    u8g2.setFont(u8g2_font_4x6_tr);
    drawLetters();
    u8g2.drawXBMP(78, 43, 5, 3, image_SmallArrowDown_bits);
    u8g2.drawXBMP(18, 54, 4, 7, image_ButtonRight_bits);
    u8g2.drawXBMP(107, 54, 4, 7, image_ButtonLeft_bits);
    u8g2.drawXBMP(86, 21, 4, 7, image_ButtonLeft_bits);
    u8g2.drawStr(46, 27, top5names[index]);
    drawCursor();
    u8g2.sendBuffer();
}


/**
 * Inializes new string and puts it to the array.
 * @param index Index of the array where new string is located.
 * @param len maxium length of the string.
 */
void newString(byte index, byte len){
  char* str = (char*)calloc(len, sizeof(char)); // Creates array of null characters.
  top5names[index] = str;
  str = nullptr;
}


/**
 * Adds char to the string from integer value.
 * @param string pointer to the c style string used.
 * @param max_size maxium size of the string.
 */
void writeLetter(char* string, byte max_size){
  if (string == nullptr) return;
  byte nextCharIndex = 0;
  while(string[nextCharIndex] != '\0'){
    nextCharIndex++;
  }
  if (nextCharIndex >= max_size) return;
  string[nextCharIndex] = (char)characterOnPoint;
  string[nextCharIndex+1] = '\0'; //Not necessary when using calloc, but doesn't hurt to be safe.
  cursorPosition += 4;
}


/**
 * Draws characters to the screen from integer.
 */
void drawLetters(void){
  char str[2]; // drawStr expects string as argument, so we shall create string with chosen character and null character.
  str[1] = '\0';
  for(int8_t pos = -2; pos<3; pos++){
    char ch = (char)characterOnPoint + pos;
    // Adjust the list so it makes characters go around.
    if (characterOnPoint + pos < 65) ch = (char)(90 + (pos+(characterOnPoint-65)+1));
    else if (characterOnPoint + pos > 90) ch = (char)(65 + (pos+(characterOnPoint-90)-1));
    str[0] = ch;
    u8g2.drawStr(79, 13 + (pos + 2)*7, str);
  }
}


/**
 * Draws flickering cursor on screen. 
 */
void drawCursor(void){
  unsigned long currentMillis = millis();
    if (currentMillis - lastCursorDrawTime_ms >= 750){
      draw = !draw;
      lastCursorDrawTime_ms = currentMillis;
    }
    if (draw) u8g2.drawLine(cursorPosition, 21, cursorPosition, 27);
    else {}
}


/**
 * Renders spinning rotor frame.
 */
void loadingScreen(byte &frame) {
  const unsigned char* bitmapPtr;
  memcpy_P(&bitmapPtr, &animations[frame], sizeof(bitmapPtr)); // Gets the bitmap pointer from flash memory.

  u8g2.clearBuffer();
  u8g2.drawXBMP(51, 18, 27, 20, image_AlgoTextFixed_bits);
  u8g2.drawXBMP(41, 9, 46, 46, bitmapPtr);
  u8g2.sendBuffer();

  frame++;
  if (frame > 11) frame = 0;
}


/**
 * Shows sensor reading on screen.
 */
void showSensorReading(void){
  avgReading = average();
  //dtostrf(calculatePromilles(avgReading), 7, 2, str); // convert float to string with max length of 7 and precision of 2 decimals.
  sprintf(str, "%d", avgReading); // does not support float conversion.
  //Serial.println(str); // for debugging
  u8g2.clearBuffer();
  u8g2.setFont(u8g2_font_6x12_tr);
  u8g2.drawStr(29, 14, "Your Reading");
  u8g2.setFont(u8g2_font_timR10_tr);
  u8g2.drawStr(50, 39, str);
  u8g2.sendBuffer();
}


/**
 * These two should be combined.
 */
void showEmpty(void){
  u8g2.clearBuffer();
  u8g2.setFont(u8g2_font_6x12_tr);
  u8g2.drawStr(9, 39, "Press button for 3s");
  u8g2.sendBuffer();
}


void showReading(void){
  u8g2.clearBuffer();
  u8g2.setFont(u8g2_font_6x12_tr);
  u8g2.drawStr(9, 39, "Collecting data...");
  u8g2.sendBuffer();
}


/**
 * Reads sensor value and saves it to the array. If last index is reached, it will start over.
 */
int readSensor(void){
  data[datapos++] = analogRead(sensorAnalogA1);
  if (lkm < 30) lkm++;
  if(datapos > 29) {
    datapos = 0;
    return data[29];
  }
  return data[datapos - 1];
}


/**
 * Calculates average sensor value.
 */
int average(void){
  int sum = 0;
  for(byte i = 0; i < lkm; i++) {
    sum += data[i];
  }
  return sum/lkm;
}


/**
 * Sets pin change interrupts on or off on port d, pin d2.
 * TODO: Improve, so that the pins can be chosen.
 */
void setPci(bool onOff){
  if (onOff){
    PCICR |= B00000100; // Enable port D
    PCMSK2 |= B00000100; // Enable pin D2
  }
  else{
    PCICR |= B00000000;
    PCMSK2 |= B00000000;
  } 
}


/**
 * Writes string array data into EEPROM. Stores array sizes as well.
 * @param eepromAddress Memory address, where to start writing. 
 * @param strArray c-style string array pointer
 * @param arraySize size of the array
 * @param static_size static string size, allows saving endline characters so memory does not need to be rewritten all the time.
 * @return Last written memory address. 
 */
int storeStringArray(int eepromAddress, char* strArray[], int arraySize, const int static_size=-1) {
    int addr = eepromAddress;
    EEPROM.put(addr, arraySize); // Store the number of strings
    addr += sizeof(int);

    for (int i = 0; i < arraySize; i++) {
        int length = static_size;
        if (static_size == -1) length = strlen(strArray[i]); //Does not store endline character.
        EEPROM.put(addr, length); // Store the length of the string.
        addr += sizeof(int);
        for (int j = 0; j < length; j++) {
            EEPROM.update(addr++, strArray[i][j]); // Store the string character by character.
        }
    }
    return addr;
}


/**
 * Reads string array data into EEPROM. Reads array sizes as well.
 * Make sure that that strArray elements are nullptrs! Otherwise memory will leak.
 * @param eepromAddress Memory address, where to start writing. 
 * @param strArray c-style string array pointer
 * @param arraySize size of the array
 * @param static_size static string size, allows saving endline characters so memory does not need to be rewritten all the time.
 * @return Last read memory address. 
 */
int retrieveStringArray(int eepromAddress, char* strArray[], int maxArraySize, const int static_size=0) {
    int addr = eepromAddress;
    int arraySize;
    EEPROM.get(addr, arraySize); // Read the number of strings
    addr += sizeof(int);

    if (static_size > 0 && arraySize == 0) arraySize = maxArraySize; // Perhaps needed to get calloc called on first try.

    for (int i = 0; i < arraySize && i < maxArraySize; i++) {
        int length;
        EEPROM.get(addr, length); // Read the length of the string
        addr += sizeof(int);
        
        if (static_size > 0) length = static_size; // If size of the string needs to be determined beforehand.
        
        strArray[i] = (char*)calloc(length + 1, sizeof(char)); // Allocate memory for the string
        for (int j = 0; j < length; j++) {
            strArray[i][j] = EEPROM.read(addr++); // Read the string character by character
        }
    }
    return addr;
}
